## prj.conf
```kconfig
CONFIG_GPIO=y
CONFIG_SPI=y
CONFIG_I2C=y
CONFIG_PRINTK=y

CONFIG_USB_DEVICE_STACK=y
CONFIG_USB_DEVICE_MANUFACTURER="ALPACAS"
CONFIG_USB_DEVICE_PRODUCT="Console"
CONFIG_USB_DEVICE_VID=0x424C
CONFIG_USB_DEVICE_PID=0x0666

CONFIG_SERIAL=y
CONFIG_CONSOLE=y
CONFIG_UART_CONSOLE=y
CONFIG_UART_LINE_CTRL=y
CONFIG_SERIAL=y

CONFIG_SENSOR=y
CONFIG_VL53L0X=y
CONFIG_VL53L0X_PROXIMITY_THRESHOLD=100


CONFIG_LOG=n
# CONFIG_BOOT_BANNER=n       
# CONFIG_PRINTK=n
# CONFIG_EARLY_CONSOLE=n
# CONFIG_OVERRIDE_FRAME_POINTER_DEFAULT=y
# CONFIG_BUILD_OUTPUT_STRIPPED=y
# CONFIG_FAULT_DUMP=0
# CONFIG_STACK_SENTINEL=y
```

## src/main.c
```c
/**
 * mam.c
 *
 *  @date Created at:	09/05/2022 11:50:04
 *	@author:	Pedro Igor B. S.
 *	@email:		pedro.igor.ifsp@gmail.com
 * 	GitHub:		https://github.com/pedro-ibs
 * 	tabSize:	8
 *
 * #######################################################################
 *
 * TODO: Licence
 *
 *   Copyright (C) Pedro Igor B. S 2021
 * -------------------------------------------------------------------
 *
 *   Licença: GNU GPL 2
 * -------------------------------------------------------------------
 *   This program is free software; you can redistribute it and/or
 *   modify it under the terms of the GNU General Public License as
 *   published by the Free Software Foundation; version 2 of the
 *   License.
 *
 *   This program is distributed in the hope that it will be useful,
 *   but WITHOUT ANY WARRANTY; without even the implied warranty of
 *   MERCHANTABILITY or FITNESS FOR A PARTICULAR PURPOSE.  See the
 *   GNU General Public License for more details.
 * -------------------------------------------------------------------
 * #######################################################################
 *
 *
 * PISCA TIMER
 *
 */

/* Includes ----------------------------------------------------------------------------------------------------------------------------------------------*/
#include <string.h>
#include <stdlib.h>
#include <stdio.h>

#include <zephyr.h>
#include <device.h>
#include <errno.h>

#include <sys/util.h>
#include <sys/printk.h>

#include <drivers/uart.h>
#include <drivers/gpio.h>
#include <drivers/i2c.h>
#include <drivers/sensor.h>

#include <usb/usb_device.h>


#include <hardware.h>
#include <usb_cdc_acm_uart.h>
#include <led.h>
#include <vl53l0x.h>


/* Setings -----------------------------------------------------------------------------------------------------------------------------------------------*/

/* Function prototype ------------------------------------------------------------------------------------------------------------------------------------*/
void vl53l0x(void);
/* Setup -------------------------------------------------------------------------------------------------------------------------------------------------*/
/* -------------------------------------------------------------------------------------------------------------------------------------------------------*/

void main(void) {	
	led_vSetup();

	usb_vSetup();

	led_vPeriodicPingStart(K_SECONDS(1));

	printk("started \r\n");

	vl53l0x();
}

/*########################################################################################################################################################*/
/*########################################################################################################################################################*/
/*########################################################################################################################################################*/
/*-------------------------------------------------------------------- Local Functions -------------------------------------------------------------------*/
/*########################################################################################################################################################*/
```
